## Documentation/devicetree/bindings/i2c/i2c-sunxi-p2wi.txt
```
* Allwinner P2WI (Push/Pull 2 Wire Interface) controller

Required properties :

 - reg             : Offset and length of the register set for the device.
 - compatible      : Should one of the following:
                     - "allwinner,sun6i-a31-p2wi"
 - interrupts      : The interrupt line connected to the P2WI peripheral.
 - clocks          : The gate clk connected to the P2WI peripheral.
 - resets          : The reset line connected to the P2WI peripheral.

Optional properties :

 - clock-frequency : Desired P2WI bus clock frequency in Hz. If not set the
default frequency is 100kHz

Example:

	p2wi@01f03400 {
		compatible = "allwinner,sun6i-a31-p2wi";
		reg = <0x01f03400 0x400>;
		interrupts = <0 39 4>;
		clocks = <&apb0_gates 3>;
		clock-frequency = <6000000>;
		resets = <&apb0_rst 3>;
	};
```

## Documentation/devicetree/bindings/mfd/axp20x.txt
```
* axp20x device tree bindings

The axp20x family current members :-
axp202 (X-Powers)
axp209 (X-Powers)

Required properties:
- compatible 			: Should be "x-powers,axp202" or "x-powers,axp209"
- interrupt-controller 		: axp20x has its own internal IRQs
- #interrupt-cells 		: Should be set to 1
- interrupt-parent 		: The parent interrupt controller
- interrupts 			: Interrupt specifiers for interrupt sources
- reg 				: The I2C slave address for the AXP chip

Sub-nodes:
* regulators : Contain the regulator nodes. The regulators are bound using
	       their name as listed here: dcdc2, dcdc3, ldo1, ldo2, ldo3,
	       ldo4, ldo5.
	       The bindings details of individual regulator device can be found in:
	       Documentation/devicetree/bindings/regulator/regulator.txt with the
	       exception of:

	- x-powers,dcdc-freq	: defines the work frequency of DC-DC in KHz
				  (range: 750-1875). Default: 1.5MHz

	For each DCDC:
		- x-powers,dcdc-workmode: Optional. 1 for PWM mode, 0 for AUTO mode
				  	  Default: AUTO mode

Example:

axp: axp20x@34 {
	reg = <0x34>;
	interrupt-parent = <&nmi_intc>;
	interrupts = <0 8>;

	compatible = "x-powers,axp209";
	interrupt-controller;
	#interrupt-cells = <1>;

	regulators {
		dcdc-freq = <1500>;

		axp_dcdc2: dcdc2 {
			regulator-min-microvolt = <700000>;
			regulator-max-microvolt = <2275000>;
			regulator-always-on;
		};

		axp_dcdc3: dcdc3 {
			regulator-min-microvolt = <700000>;
			regulator-max-microvolt = <3500000>;
			regulator-always-on;
		};

		axp_ldo1: ldo1 {
			regulator-min-microvolt = <1300000>;
			regulator-max-microvolt = <1300000>;
		};

		axp_ldo2: ldo2 {
			regulator-min-microvolt = <1800000>;
			regulator-max-microvolt = <3300000>;
			regulator-always-on;
		};

		axp_ldo3: ldo3 {
			regulator-min-microvolt = <700000>;
			regulator-max-microvolt = <3500000>;
		};

		axp_ldo4: ldo4 {
			regulator-min-microvolt = <1250000>;
			regulator-max-microvolt = <3300000>;
		};

		axp_ldo5: ldo5 {
			regulator-min-microvolt = <1800000>;
			regulator-max-microvolt = <3300000>;
		};
	};
};
```

## Documentation/devicetree/bindings/mfd/sun6i-prcm.txt
```
* Allwinner PRCM (Power/Reset/Clock Management) Multi-Functional Device

PRCM is an MFD device exposing several Power Management related devices
(like clks and reset controllers).

Required properties:
 - compatible: "allwinner,sun6i-a31-prcm"
 - reg: The PRCM registers range

The prcm node may contain several subdevices definitions:
 - see Documentation/devicetree/clk/sunxi.txt for clock devices
 - see Documentation/devicetree/reset/allwinner,sunxi-clock-reset.txt for reset
   controller devices


Example:

	prcm: prcm@01f01400 {
		compatible = "allwinner,sun6i-a31-prcm";
		reg = <0x01f01400>;

		/* Put subdevices here */
		ar100_mux: ar100_mux {
			compatible = "allwinner,sun6i-a31-ar100-mux-clk";
			#clock-cells = <0>;
			clocks = <&osc32k>, <&osc24M>, <&pll6>, <&pll6>;
		};

		ar100: ar100 {
			compatible = "allwinner,sun6i-a31-ar100-clk";
			#clock-cells = <0>;
			clocks = <&ar100_mux>;
		};

		ar100_div: ar100_div {
			compatible = "allwinner,sun6i-a31-ar100-div-clk";
			#clock-cells = <0>;
			clocks = <&ar100>;
		};

		ahb0: ahb0 {
			compatible = "fixed-factor-clock";
			#clock-cells = <0>;
			clock-div = <1>;
			clock-mult = <1>;
			clocks = <&ar100_div>;
			clock-output-names = "ahb0";
		};

		apb0: apb0 {
			compatible = "allwinner,sun6i-a31-apb0-clk";
			#clock-cells = <0>;
			clocks = <&ahb0>;
			clock-output-names = "apb0";
		};

		apb0_gates: apb0_gates {
			compatible = "allwinner,sun6i-a31-apb0-gates-clk";
			#clock-cells = <1>;
			clocks = <&apb0>;
			clock-output-names = "apb0_pio", "apb0_ir",
					"apb0_timer01", "apb0_p2wi",
					"apb0_uart", "apb0_1wire",
					"apb0_i2c";
		};

		apb0_rst: apb0_rst {
			compatible = "allwinner,sun6i-a31-clock-reset";
			#reset-cells = <1>;
		};
	};
```

## Documentation/devicetree/bindings/mtd/nand.txt
```
* MTD generic binding

- nand-ecc-mode : String, operation mode of the NAND ecc mode.
  Supported values are: "none", "soft", "hw", "hw_syndrome", "hw_oob_first",
  "soft_bch".
- nand-bus-width : 8 or 16 bus width if not present 8
- nand-on-flash-bbt: boolean to enable on flash bbt option if not present false
<<<<<<< HEAD

- nand-ecc-strength: integer representing the number of bits to correct
		     per ECC step.

- nand-ecc-step-size: integer representing the number of data bytes
		      that are covered by a single ECC step.

The ECC strength and ECC step size properties define the correction capability
of a controller. Together, they say a controller can correct "{strength} bit
errors per {size} bytes".

The interpretation of these parameters is implementation-defined, so not all
implementations must support all possible combinations. However, implementations
are encouraged to further specify the value(s) they support.

- onfi,nand-timing-mode: an integer encoding the supported ONFI timing modes of
  the NAND chip. Each supported mode is represented as a bit position (i.e. :
  mode 0 and 1 => (1 << 0) | (1 << 1) = 0x3).
  This is only used when the chip does not support the ONFI standard.
  The last bit set represent the closest mode fulfilling the NAND chip timings.
  For a full description of the different timing modes see this document:
  www.onfi.org/~/media/ONFI/specs/onfi_3_1_spec.pdf‎
```

## drivers/gpu/drm/sunxi/Kconfig
```kconfig
config DRM_SUNXI
	tristate "DRM Support for Allwinner Display Engine"
	depends on DRM && ARM
	depends on ARCH_SUNXI || COMPILE_TEST
	select DRM_KMS_HELPER
	select DRM_KMS_CMA_HELPER
	select DRM_GEM_CMA_HELPER
	select DRM_KMS_FB_HELPER
	select VIDEOMODE_HELPERS
	help
	  Choose this option if you have an Allwinner SoC with a Display Engine.
	  If M is selected the module will be called sunxi-drm.
```
